/dts-v1/;
/plugin/;

/ {
    compatible = "brcm,bcm2835";

    fragment@0 {
        target-path = "/";
        __overlay__ {
            pisugar_button: pisugar_button {
                compatible = "gpio-keys";

                button@3 {
                    label = "POWER";    /* PiSugar power */
                    linux,code = <116>; /* KEY_POWER     */
                    gpios = <&gpio 3 1>;
                    debounce-interval = <20>;
                };
            };
        };
    };
};